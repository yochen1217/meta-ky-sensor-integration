## conf/layer.conf
```bitbake
# We have a conf and classes directory, add to BBPATH
BBPATH .= ":${LAYERDIR}"

# We have recipes-* directories, add to BBFILES
BBFILES += "${LAYERDIR}/recipes-*/*/*.bb \
            ${LAYERDIR}/recipes-*/*/*.bbappend"

BBFILE_COLLECTIONS += "meta-ky-romulus"
BBFILE_PATTERN_meta-ky-romulus = "^${LAYERDIR}/"
BBFILE_PRIORITY_meta-ky-romulus = "6"

LAYERDEPENDS_meta-ky-romulus = "core"
LAYERSERIES_COMPAT_meta-ky-romulus = "walnascar"
```
